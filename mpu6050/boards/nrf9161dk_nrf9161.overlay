/*
 * Copyright (c) 2019 Nordic Semiconductor ASA
 *
 * SPDX-License-Identifier: Apache-2.0
 */

&i2c2 {
	// status = "okay";
	// pinctrl-names = "default";
	// pinctrl-0 = <&i2c2_default>;

	mpu6050: mpu6050@68 {
		compatible = "invensense,mpu6050";
		reg = <0x68>;
		status = "okay";
		int-gpios = <&gpio0 5 GPIO_ACTIVE_HIGH>;
	};
};
