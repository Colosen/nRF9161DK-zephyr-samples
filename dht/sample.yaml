## dht/sample.yaml
```yaml
#
# Copyright (c) 2019 Nordic Semiconductor ASA
#
# SPDX-License-Identifier: Apache-2.0
#

common:
  filter: CONFIG_FULL_LIBC_SUPPORTED
sample:
  name: DHT Sensor Sample
tests:
  sample.sensor.dht:
    build_only: true
    platform_allow: nrf9161dk/nrf9161
    integration_platforms:
      - nrf9161dk/nrf9161
    tags: sensors
```
